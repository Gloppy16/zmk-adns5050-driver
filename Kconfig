## Kconfig
```kconfig
# Copyright (c) 2026 Gloppy16
# SPDX-License-Identifier: GPL-2.0-or-later

menuconfig ADNS5050
	bool "ADNS-5050 optical mouse sensor (bit-banged 3-wire)"
	default y
	depends on DT_HAS_PIXART_ADNS5050_ENABLED
	depends on GPIO
	depends on INPUT
	help
	  Enable the driver for Pixart ADNS-5050 optical mouse sensors
	  connected over a bit-banged 3-wire serial bus (SCLK / SDIO / CS).
	  The sensor is polled; no MOTION interrupt line is required.

if ADNS5050

module = ADNS5050
module-str = adns5050
source "subsys/logging/Kconfig.template.log_config"

config ADNS5050_INIT_RETRIES
	int "Signature-check retry attempts before declaring the bus dead"
	default 5
	range 1 20
	help
	  Number of full init attempts (sync pulse, Chip_Reset 0x5a write,
	  55 ms wake, prime burst, signature reads incl. the Inv_Rev_ID 0xfe
	  cross-check) before the sensor is declared absent. Attempts are
	  spaced ADNS5050_INIT_RETRY_MS apart. After a failed cycle the
	  driver re-arms one full cycle later, so a marginal joint that
	  re-makes contact recovers without a reflash.

config ADNS5050_INIT_RETRY_MS
	int "Delay between init signature-check retries (ms)"
	default 2000
	range 100 60000

config ADNS5050_HEALTH_CHECK_MS
	int "Runtime health-check period (ms, 0 = off)"
	default 1000
	range 0 60000
	help
	  While the sensor is ready, periodically read Product_ID and one
	  motion burst. A Product_ID mismatch, or ADNS5050_HEALTH_STRIKES
	  consecutive saturated (0xFF-class) delta pairs - the signature of
	  a re-opening SDIO joint - stops the poll timer, marks the sensor
	  not-ready and re-runs the init retry loop. 0 disables the health
	  check entirely.

config ADNS5050_HEALTH_STRIKES
	int "Consecutive saturated deltas before a health-check re-init"
	default 3
	range 1 20
	help
	  Number of consecutive health checks that must observe a saturated
	  delta pair (raw dx/dy of -1 and/or 0, i.e. 0xFF-class bytes)
	  before the driver self-heals. Raise this if legitimate very slow
	  diagonal movement is ever mistaken for a stuck line.

config ADNS5050_TSCLK_NCS_WRITE_US
	int "tSCLK-NCS write hold time (us)"
	default 20
	range 1 100
	help
	  Minimum time between the last SCLK rising edge of a write transfer
	  and raising NCS. ADNS-5050 datasheet (AV02-1045EN) p12 AC table,
	  tSCLK-NCS write case: 20 us minimum "for valid SDIO data transfer".
	  QMK and earlier versions of this driver raised NCS after only the
	  ~4 us serial_write tail, below this minimum, so register writes
	  (CPI, power-down, Chip_Reset) could silently abort. Leave at 20
	  unless a bench scope says otherwise.

endif # ADNS5050
```

## dts/bindings/pixart,adns5050.yml
```yaml
# Copyright (c) 2026 Gloppy16
# SPDX-License-Identifier: GPL-2.0-or-later
#
# ADNS-5050 over a 3-wire bit-banged bus (SCLK / SDIO / CS), no SPI hardware,
# no MOTION interrupt line. Polling driver for ZMK.

description: |
  Pixart ADNS-5050 optical mouse sensor, bit-banged 3-wire serial bus.

  The ADNS-5050 uses a half-duplex single-data-line serial protocol that
  hardware SPI controllers (e.g. nRF SPIM) cannot drive, so the three
  signal pins are bit-banged as plain GPIOs:

    sclk-gpios = serial clock, idles LOW
    sdio-gpios = bidirectional data line
    cs-gpios   = chip select, idles HIGH, active LOW

  Motion is polled; there is no MOTION pin on the cocot46plus trackball.

compatible: "pixart,adns5050"

properties:
  vcc-gpios:
    type: phandle-array
    required: false
    description: |
      Optional control pin for the sensor's supply rail (load-switch enable).

      The driver drives it ACTIVE at device init and re-asserts it at the
      top of EVERY init attempt, then waits ADNS5050_POWER_UP_DELAY_MS
      (once per init cycle) before the first bus transaction.

      CAUTION: on boards whose sensor rides a switched rail (nice!nano:
      the Pro Micro VCC pin is gated by an internal load switch on P0.13),
      this MUST point at the SAME GPIO the board's ext_power node controls
      - e.g. <&gpio0 13 GPIO_ACTIVE_HIGH> on nice_nano_v2 - making this a
      deliberate second owner of that pin, not a second pin. That is the
      point: ZMK consumers of the rail (underglow AUTO_OFF_IDLE calling
      ext_power_disable, or an NVS-restored ext_power off-state) can cut
      it behind this driver's back; re-asserting here guarantees the
      sensor stays powered regardless.

  sclk-gpios:
    type: phandle-array
    required: true
    description: Serial clock pin (idles low).

  sdio-gpios:
    type: phandle-array
    required: true
    description: Bidirectional serial data pin.

  cs-gpios:
    type: phandle-array
    required: true
    description: Chip select pin (active low).

  cpi:
    type: int
    default: 500
    enum:
      - 125
      - 250
      - 375
      - 500
      - 625
      - 750
      - 875
      - 1000
      - 1125
      - 1250
      - 1375
    description: |
      Counts per inch, in 125 CPI steps (register value 1..13).
      Default 500, matching QMK's cocot46plus default.

  invert-x:
    type: boolean
    description: Invert the reported X axis direction.

  invert-y:
    type: boolean
    description: Invert the reported Y axis direction.

  scroll-layers:
    type: array
    default: []
    description: |
      Layer indexes on which trackball motion is reported as wheel
      scrolling instead of cursor movement. The value is compared
      against zmk_keymap_highest_layer_active().
```
